## network-node/boards/esp32s3-16mb/sdkconfig.defaults
```kconfig
CONFIG_ESPTOOLPY_FLASHSIZE_16MB=y
CONFIG_PARTITION_TABLE_CUSTOM=y
CONFIG_PARTITION_TABLE_CUSTOM_FILENAME="boards/esp32s3-16mb/partitions.csv"
```

## network-node/sdkconfig.defaults
```kconfig
CONFIG_MBEDTLS_CERTIFICATE_BUNDLE=y
CONFIG_ESP_OPENCLAW_NODE_MAX_CAPABILITIES=4
CONFIG_ESP_OPENCLAW_NODE_MAX_COMMANDS=4
CONFIG_ESP_OPENCLAW_NODE_MAX_INBOUND_MESSAGE_SIZE=32768
CONFIG_ESP_MAIN_TASK_STACK_SIZE=8192
CONFIG_HTTPD_MAX_REQ_HDR_LEN=1024
CONFIG_HTTPD_MAX_URI_LEN=128
CONFIG_LWIP_MAX_SOCKETS=16
CONFIG_LOG_DEFAULT_LEVEL_WARN=y
CONFIG_ESP_CONSOLE_UART_DEFAULT=y
CONFIG_ESP_CONSOLE_UART_BAUDRATE=115200
# The default cJSON recursion limit (1000) exceeds small FreeRTOS task stacks.
CONFIG_CJSON_NESTING_LIMIT=16
CONFIG_CJSON_CIRCULAR_LIMIT=16
```
